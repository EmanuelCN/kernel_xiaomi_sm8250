## drivers/block/vbswap/Kconfig
```kconfig
config VBSWAP
	tristate "Fake block device for swap based on vnswap"
	depends on BLOCK && ZSWAP
	default n
```

## drivers/block/zram/Kconfig
```kconfig
# SPDX-License-Identifier: GPL-2.0
config ZRAM
	tristate "Compressed RAM block device support"
	depends on BLOCK && SYSFS && ZSMALLOC && CRYPTO
	default n
	help
	  Creates virtual block devices called /dev/zramX (X = 0, 1, ...).
	  Pages written to these disks are compressed and stored in memory
	  itself. These disks allow very fast I/O and compression provides
	  good amounts of memory savings.

	  It has several use cases, for example: /tmp storage, use as swap
	  disks and maybe many more.

	  See Documentation/blockdev/zram.txt for more information.

choice
	prompt "Default zram compressor"
	default ZRAM_DEF_COMP_LZ4
	depends on ZRAM

config ZRAM_DEF_COMP_LZO
	bool "lzo"
	select CRYPTO_LZO

config ZRAM_DEF_COMP_ZSTD
	bool "zstd"
	select CRYPTO_ZSTD

config ZRAM_DEF_COMP_LZ4
	bool "lz4"
	select CRYPTO_LZ4

endchoice

config ZRAM_DEF_COMP
	string
	default "lzo" if ZRAM_DEF_COMP_LZO
	default "zstd" if ZRAM_DEF_COMP_ZSTD
	default "lz4" if ZRAM_DEF_COMP_LZ4

config ZRAM_WRITEBACK
       bool "Write back incompressible or idle page to backing device"
       depends on ZRAM
       default n
       help
	 With incompressible page, there is no memory saving to keep it
	 in memory. Instead, write it out to backing device.
	 For this feature, admin should set up backing device via
	 /sys/block/zramX/backing_dev.

	 With /sys/block/zramX/{idle,writeback}, application could ask
	 idle page's writeback to the backing device to save in memory.

	 See Documentation/blockdev/zram.txt for more information.

config ZRAM_MEMORY_TRACKING
	bool "Track zRam block status"
	depends on ZRAM && DEBUG_FS
	help
	  With this feature, admin can track the state of allocated blocks
	  of zRAM. Admin could see the information via
	  /sys/kernel/debug/zram/zramX/block_state.

	  See Documentation/blockdev/zram.txt for more information.
```

## drivers/char/srandom/Kconfig
```kconfig
config SRANDOM
	tristate "Seed Random Number Generator by josenk"
	default n
	depends on !HW_RANDOM

	---help---
	  This driver provides kernel-side support for
	  Seed Random Number Generator.

	  To compile this driver as a module, choose M here: the
	  module will be called srandom.

	  If unsure, say N.
```

## drivers/input/keyboard/nanosic_driver/Kconfig
```kconfig
config KEYBOARD_NANO_8030
	tristate "Nanosic 8030 Keyboard"
	depends on I2C
	help
	  Say Y here if you have a Nanosic 8030 I2C Keyboard.

	  To compile this driver as a module, choose M here: the
	  module will be called nanosic_driver.
```

## drivers/input/misc/aw8697_haptic/Kconfig
```kconfig
#
# Awinic aw8697 driver
#

config INPUT_AW8697_HAPTIC
	tristate "Awinic AW8697 HAPTIC"
	depends on I2C
	help
	  Say Y here if you have Awinic AW8697 haptic controller
	  chip in your system.

	  If unsure, say N.

	  To compile this driver as a module, choose M here.

config INPUT_AW8697_HAPTIC_DAGU
	bool "Awinic AW8697 HAPTIC dagu driver"
	depends on INPUT_AW8697_HAPTIC
	help
	  Say Y here if you want to use the AW8697 driver from
	  dagu.

	  If unsure, say N.
```

## drivers/input/misc/xiaomi_keyboard/Kconfig
```kconfig
config INPUT_XIAOMI_KEYBOARD
	tristate "xiaomi keyboard control-driver"
	depends on INPUT
	help
	  Say Y here, compile xiaomi keyboard control driver.

	  If unsure, say N.
```

## drivers/input/touchscreen/focaltech_3658u/Kconfig
```kconfig
#
# Focaltech Touchscreen driver configuration
#

config TOUCHSCREEN_FOCALTECH_3658U
	tristate "Focaltech Touchscreen"
	default n
	help
	  Say Y here if you have Focaltech touch panel.

	  If unsure, say N.

	  To compile this driver as a module, choose M here: the
	  module will be called focaltech_touch.
```

## drivers/input/touchscreen/focaltech_touch_mi/Kconfig
```kconfig
#
# Focaltech Touchscreen driver configuration
#

config TOUCHSCREEN_FTS_MI
	bool "Focaltech Touchscreen"
	depends on I2C
	default n
	help
	  Say Y here if you have Focaltech touch panel.
	  If unsure, say N.

config TOUCHSCREEN_FTS_FOD
	bool "Focaltech Touchscreen Fod func"
	depends on TOUCHSCREEN_FTS_MI
	default n
	help
	  Say Y here if you support fod function.
	  If unsure, say N.
```

## drivers/input/touchscreen/xiaomi/Kconfig
```kconfig
config TOUCHSCREEN_XIAOMI_TOUCHFEATURE
	tristate "Xiaomi Touch Feature"
	depends on INPUT_TOUCHSCREEN
	help
	  Say Y here if you enable xiaomi touch feature.

	  If unsure, say N.

	  To compile this driver as a module, choose M here:

config TOUCHSCREEN_SUPPORT_NEW_GAME_MODE
	bool "Touch Support New Game Mode"
	help
	  Say Y here if the device support new game mode

	  If not support, say N.
```

## drivers/power/supply/lionsemi/Kconfig
```kconfig
# SPDX-License-Identifier: GPL-2.0-only

menu "Lion Semiconductor Inc. Charger and Fuel Gauge support"

config CHARGER_LN8000
	tristate "LionSemi LN8000 Battery Charger"
	depends on I2C
	select PD_POLICY_MANAGER
	select REGMAP_I2C
	help
	  Say Y to enable support for the LN8000 charger

config CHARGER_LN8000_MUNCH
	tristate "LionSemi LN8000 Battery Charger"
	depends on I2C
	select PD_POLICY_MANAGER_MUNCH
	select REGMAP_I2C
	help
	  Say Y to enable support for the LN8000 charger

config CHARGER_LN8000_PSYCHE
	tristate "LionSemi LN8000 Battery Charger"
	depends on I2C
	select PD_POLICY_MANAGER_PSYCHE
	select REGMAP_I2C
	help
	  Say Y to enable support for the LN8000 charger

config LN8282
	tristate "LN8282 Charge Pump"
	depends on I2C
	help
	  Say Y to include support for LN8282 charger pump.
	  Lion Semiconductor Inc. LN8282 is a charger pump chip.
	  The driver supports charger enable/disable.
	  The driver reports the charger status via the power supply framework.
	  The driver controls 8282 via I2C and
	  supports device-tree interface.

endmenu
```

## drivers/power/supply/maxim/Kconfig
```kconfig
# SPDX-License-Identifier: GPL-2.0-only

menu "Maxim Integrated Charger and Fuel Gauge support"

config BATT_VERIFY_BY_DS28E16
	bool "Support ds28e16 as encryption IC."
	help
		It needs a onewire physical controller to work.

config ONEWIRE_GPIO
	bool "Support Onewire Driver."
	help
		It's an onewire driver.

config WATCHDOG_MAX28200
	tristate "maxim watch dog max28200 driver"
	help
	  Say Y to enable support for maxim max28200 driver

config CP_MAX77932
	tristate "maxim charger pump max77932 driver"
	help
	  Say Y to enable support for charger pump driver

endmenu
```

## drivers/power/supply/nuvolta/Kconfig
```kconfig
# SPDX-License-Identifier: GPL-2.0-only

menu "NuVolta Technologies Inc. Charger and Fuel Gauge support"

config RX1619
	tristate "RX1619 wireless Charger"
	depends on I2C
	help
	  Say Y to include support for rx1619 wireless Charger.
	  RX1619 is a wireless battery charger chip.
	  The driver supports charger enable/disable.
	  The driver reports the charger status via the power supply framework.
	  The driver controls rx1619 via I2C and
	  supports device-tree interface.

config RX1619_CAS
	tristate "RX1619 wireless Charger"
	depends on I2C
	help
	  Say Y to include support for rx1619 wireless Charger.
	  RX1619 is a wireless battery charger chip.
	  The driver supports charger enable/disable.
	  The driver reports the charger status via the power supply framework.
	  The driver controls rx1619 via I2C and
	  supports device-tree interface.

config RX1619_TRIM
	tristate "RX1619 TRIM"
	depends on I2C
	help
	  Say Y to include support for rx1619 wireless Charger.
	  RX1619 is a wireless battery charger chip.
	  The driver supports charger enable/disable.
	  The driver reports the charger status via the power supply framework.
	  The driver controls rx1619 via I2C and
	  supports device-tree interface.

config RX1619_TRIM_CAS
	tristate "RX1619 TRIM"
	depends on I2C
	help
	  Say Y to include support for rx1619 wireless Charger.
	  RX1619 is a wireless battery charger chip.
	  The driver supports charger enable/disable.
	  The driver reports the charger status via the power supply framework.
	  The driver controls rx1619 via I2C and
	  supports device-tree interface.

config RX1619_REMOVE
	bool "J2S special modify."
	depends on I2C
	help
	  J2S special modify

config RX_ON_URD
	tristate "RX chip on urd device"
	depends on I2C
	help
	  Say Y to include support for rx wireless Charger on URD.
	  supports device-tree interface.

endmenu
```

## drivers/power/supply/qcom_cas/Kconfig
```kconfig
# SPDX-License-Identifier: GPL-2.0-only

menu "Qualcomm Technologies, Inc. Charger and Fuel Gauge support"

config QPNP_SMB5_CAS
	tristate "SMB5 Battery Charger"
	depends on MFD_SPMI_PMIC
	help
	  Say Y to enables support for the SMB5 charging peripheral.
	  The QPNP SMB5 charger driver supports the charger peripheral
	  present in the chip.
	  The power supply framework is used to communicate battery and
	  usb properties to userspace and other driver consumers such
	  as fuel gauge, USB, and USB-PD.
	  VBUS and VCONN regulators are registered for supporting OTG,
	  and powered Type-C cables respectively.

config SMB1398_CHARGER_CAS
	tristate "SMB1398 power supply framework based driver"
	depends on MFD_I2C_PMIC
	help
	  Say Y to include the support of SMB1398 Charge driver based on power
	  supply framework.
	  SMB1398 is a combo charger chip which can work in different modes:
	  (1) DIV2 charge pump mode to work as a companion charger to be paired
	      with Qualcomm Technologies, Inc.’s family of standalone chargers;
	  (2) DIV2 and 3-level buck combo mode to regulate the output power from
	      wireless charger receiver and provide the input for downstream
	      chargers.

config FUEL_GAUGE_BQ28Z610
	tristate "TI bq28z610 battery gauge driver"
	help
	  Say Y to enable support for TI bq27z561 fuel gauge driver

endmenu
```

## drivers/power/supply/renesas/Kconfig
```kconfig
# SPDX-License-Identifier: GPL-2.0-only

menu "Renesas Electronics Corporation Charger and Fuel Gauge support"

config IDT_P9415
	tristate "idtp9415 wireless Charger"
	depends on I2C
	help
	  Say Y to include support for idtp9415 wireless Charger.
	  idtp9415 is a wireless battery charger.
	  The driver supports charger enable/disable.
	  The driver reports the charger status via the power supply framework.
	  The driver controls idtp9415 via I2C and
	  supports device-tree interface.

config IDT_P9415_CAS
	tristate "idtp9415 wireless Charger"
	depends on I2C
	help
	  Say Y to include support for idtp9415 wireless Charger.
	  idtp9415 is a wireless battery charger.
	  The driver supports charger enable/disable.
	  The driver reports the charger status via the power supply framework.
	  The driver controls idtp9415 via I2C and
	  supports device-tree interface.

config IDT_P9418
	tristate "idtp9418 wireless Charger"
	depends on I2C
	help
	  Say Y to include support for idtp9418 wireless Charger.
	  idtp9418 is a wireless battery charger.
	  The driver supports charger enable/disable.
	  The driver reports the charger status via the power supply framework.
	  The driver controls idtp9418 via I2C and
	  supports device-tree interface.

endmenu
```

## drivers/power/supply/ti/Kconfig
```kconfig
# SPDX-License-Identifier: GPL-2.0-only

menu "TI Technologies, Inc. Charger support"

config PD_POLICY_MANAGER
	tristate "TI policy manager"
	depends on I2C
	help
	  Say Y to include TI PD policy manager.

config PD_POLICY_MANAGER_DAGU
	tristate "TI policy manager"
	depends on I2C
	help
	  Say Y to include TI PD policy manager.

config PD_POLICY_MANAGER_MUNCH
	tristate "TI policy manager"
	depends on I2C
	help
	  Say Y to include TI PD policy manager.

config PD_POLICY_MANAGER_PSYCHE
	tristate "TI policy manager"
	depends on I2C
	help
	  Say Y to include TI PD policy manager.

config BQ2597X_CHARGE_PUMP
	tristate "BQ2597X power supply framework based driver"
	depends on I2C
	select PD_POLICY_MANAGER
	help
	  Say Y to include support for BQ2597X Charge Pump driver based on
	  power supply framework.
	  BQ2597X is a div2 charge pump capable of delivering 8A charge current
	  with very high efficiency.

config BQ2597X_CHARGE_PUMP_DAGU
	tristate "BQ2597X power supply framework based driver"
	depends on I2C
	select PD_POLICY_MANAGER_DAGU
	help
	  Say Y to include support for BQ2597X Charge Pump driver based on
	  power supply framework.
	  BQ2597X is a div2 charge pump capable of delivering 8A charge current
	  with very high efficiency.

config BQ2597X_CHARGE_PUMP_STANDALONE_MUNCH
	tristate "BQ2597X power supply framework based driver"
	depends on I2C
	select PD_POLICY_MANAGER_MUNCH
	help
	  Say Y to include support for BQ2597X Charge Pump driver based on
	  power supply framework.
	  BQ2597X is a div2 charge pump capable of delivering 8A charge current
	  with very high efficiency.

config BQ_PUMP_WIRELESS_CHARGE
	tristate "BQ2597X wireless dc charge policy driver"
	depends on I2C
	help
	  Say Y to include support for BQ2597X Charge Pump Wireless Charging
	  based on power supply framework.

config DUAL_BQ2597X
	tristate "BQ2597X power supply framework based driver"
	depends on I2C
	help
	  Say Y to include support for dual BQ2597X Charge Pump driver based on
	  power supply framework.

endmenu
```

## drivers/staging/qcacld-3.0/configs/qcn7605_defconfig
```kconfig
include $(WLAN_ROOT)/configs/genoa.pci.debug_defconfig

#Flag to enable/disable TARGET 11d scan
CONFIG_TARGET_11D_SCAN := y
```
